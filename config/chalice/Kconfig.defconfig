## config/chalice/Kconfig.defconfig
```kconfig
# Copyright (c) 2020 The ZMK Contributors
# SPDX-License-Identifier: MIT

if SHIELD_CHALICE

config ZMK_KEYBOARD_NAME
    default "Chalice"

endif
```

## config/chalice/Kconfig.shield
```kconfig
# Copyright (c) 2020 The ZMK Contributors
# SPDX-License-Identifier: MIT

config SHIELD_CHALICE
    def_bool $(shields_list_contains,chalice)
```

## config/west.yml
```yaml
manifest:
  remotes:
    - name: zmkfirmware
      url-base: https://github.com/zmkfirmware
    - name: joshajohnson
      url-base: https://github.com/joshajohnson
  projects:
    - name: zmk
      remote: joshajohnson
      revision: entropy
      import: app/west.yml
  self:
    path: entropy
```
